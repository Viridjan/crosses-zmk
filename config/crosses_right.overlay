/* Left trackball: pointer on normal layers */
&trackball_peripheral_listener {
    layers = < 1 >;
};
/ {
    tb_left_scroll: tb_left_scroll {
        compatible = "zmk,input-listener";
        device = <&trackball_peripheral_split>;
        layers = <SCROLL>;
        input-processors = <&zip_xy_to_scroll_mapper>, <&zip_scroll_scaler 1 4>;
    };
};
