
#include <behaviors.dtsi>
#include <dt-bindings/zmk/keys.h>
#include <dt-bindings/zmk/pointing.h>

#include <zmk-helpers/helper.h>
#include "zmk-helpers/key-labels/36.h"

#include "definitions.dtsi"
#include "behaviors.dtsi"
